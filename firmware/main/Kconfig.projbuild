## firmware/main/Kconfig.projbuild
```kconfig
menu "Tricorder diagnostic fixtures"
    config TRICORDER_JPEG_QUEUE_TIMEOUT_FIXTURE
        bool "Inject one JPEG queued timeout and expected panic"
        default n
        help
            Reserve the DMA2D TX reorder channel without starting DMA. The
            first real JPEG queues and times out. The ownership guard must
            panic before returning from the driver. Skip the fixture on its
            panic reboot. This is fault-injection firmware, not acceptance
            firmware; disable it before collecting normal workload evidence.
    config TRICORDER_GUIDED_AB_STARTUP
        bool "Boot to the start screen without automatic media diagnostics"
        default n
        help
            Initialize the board/display/radio and open the start screen. Skip
            the automatic camera/audio/DSP/baseline stages. The symbol keeps
            its A/B-era name so existing private sdkconfig files still apply.
    config TRICORDER_INVESTIGATION_ENDPOINT
        string "Initial Mac service endpoint (editable on device)"
        default ""
        help
            Optional development default such as ws://192.168.0.2:8765/.
            No credentials. Endpoint edits remain RAM-only.
endmenu
```
